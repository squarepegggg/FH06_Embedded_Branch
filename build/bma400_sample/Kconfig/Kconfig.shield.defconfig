## build/bma400_sample/Kconfig/arch/Kconfig
```kconfig
# Load Zephyr Arch Kconfig descriptions.
osource "/home/nrg-gluon/ncs/v3.1.1/zephyr/arch/rx/Kconfig"
osource "/home/nrg-gluon/ncs/v3.1.1/zephyr/arch/x86/Kconfig"
osource "/home/nrg-gluon/ncs/v3.1.1/zephyr/arch/xtensa/Kconfig"
osource "/home/nrg-gluon/ncs/v3.1.1/zephyr/arch/sparc/Kconfig"
osource "/home/nrg-gluon/ncs/v3.1.1/zephyr/arch/riscv/Kconfig"
osource "/home/nrg-gluon/ncs/v3.1.1/zephyr/arch/posix/Kconfig"
osource "/home/nrg-gluon/ncs/v3.1.1/zephyr/arch/mips/Kconfig"
osource "/home/nrg-gluon/ncs/v3.1.1/zephyr/arch/arm64/Kconfig"
osource "/home/nrg-gluon/ncs/v3.1.1/zephyr/arch/arm/Kconfig"
osource "/home/nrg-gluon/ncs/v3.1.1/zephyr/arch/arc/Kconfig"
```

## build/bma400_sample/Kconfig/boards/Kconfig
```kconfig
# Load Zephyr board Kconfig descriptions.
osource "/home/nrg-gluon/ncs/v3.1.1/zephyr/boards/nordic/nrf52dk/Kconfig"
```

## build/bma400_sample/Kconfig/boards/Kconfig.defconfig
```kconfig
# Load Zephyr board defconfig descriptions.
osource "/home/nrg-gluon/ncs/v3.1.1/zephyr/boards/nordic/nrf52dk/Kconfig.defconfig"
```

## build_solar/Kconfig/boards/Kconfig.defconfig
```kconfig
# Load Zephyr board defconfig descriptions.
osource "/opt/nordic/ncs/v3.1.1/zephyr/boards/nordic/nrf52dk/Kconfig.defconfig"
```

## build_solar/Kconfig/boards/Kconfig.nrf52dk
```kconfig
# Load board Kconfig descriptions.
osource "/opt/nordic/ncs/v3.1.1/zephyr/boards/nordic/nrf52dk/Kconfig.nrf52dk"
```
