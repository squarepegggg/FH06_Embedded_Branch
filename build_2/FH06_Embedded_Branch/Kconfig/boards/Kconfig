## build_2/FH06_Embedded_Branch/Kconfig/boards/Kconfig
```kconfig
# Load Zephyr board Kconfig descriptions.
osource "/opt/nordic/ncs/v3.2.3/zephyr/boards/nordic/nrf52dk/Kconfig"
```

## build_3/FH06_Embedded_Branch/Kconfig/Kconfig.shield
```kconfig
osource "/Users/matthew/Desktop/seniorDesign/FH06_Embedded_Branch/boards/shields/*/Kconfig.shield"
osource "/opt/nordic/ncs/v3.2.3/nrf/boards/shields/*/Kconfig.shield"
```

## build_3/FH06_Embedded_Branch/Kconfig/boards/Kconfig.defconfig
```kconfig
# Load Zephyr board defconfig descriptions.
osource "/opt/nordic/ncs/v3.2.3/zephyr/boards/nordic/nrf52dk/Kconfig.defconfig"
```

## build_3/Kconfig/Kconfig.shield.defconfig
```kconfig
osource "/Users/matthew/Desktop/seniorDesign/FH06_Embedded_Branch/boards/shields/*/Kconfig.defconfig"
osource "/opt/nordic/ncs/v3.2.3/nrf/boards/shields/*/Kconfig.defconfig"
```
